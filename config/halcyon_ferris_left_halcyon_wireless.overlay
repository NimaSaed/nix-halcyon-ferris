/*
 * Left-half devicetree overlay, wireless board only (keys + e-paper, no
 * pointing device). ZMK takes <shield>_<board>.overlay over <shield>.overlay,
 * so the wired build gets halcyon_ferris_left_halcyon_wired.overlay instead.
 *
 * USB serial console for CONFIG_ZMK_USB_LOGGING (see halcyon_ferris_left_halcyon_wireless.conf);
 * the halcyon_wireless board does not define one. Harmless when logging is off.
 */

/ {
    chosen {
        zephyr,console = &cdc_acm_uart;
    };
};

&zephyr_udc0 {
    cdc_acm_uart: cdc_acm_uart {
        compatible = "zephyr,cdc-acm-uart";
    };
};
