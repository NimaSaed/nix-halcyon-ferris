## modules/epaper-layers/Kconfig
```kconfig
config ZMK_EPAPER_LAYERS
    bool "Halcyon e-paper status screen: the keymap's layers, a dot at the active one"
    depends on ZMK_DISPLAY && ZMK_DISPLAY_STATUS_SCREEN_CUSTOM
    depends on !ZMK_SPLIT || ZMK_SPLIT_ROLE_CENTRAL
    select LV_USE_CANVAS
    select LV_FONT_MONTSERRAT_14
    help
      Provides zmk_display_status_screen() for the e-paper of splitkb's
      mod_display_epaper shield: every layer of the keymap in a column, in
      index order, with a dot in front of the one that is active (the highest
      one, as ZMK's own layer widget reports it). Only that dot moves between
      updates. Needs a part that knows the layers (a central), and splitkb's
      own status widget switched off (CONFIG_HALCYON_EPAPER_WIDGET_STATUS=n),
      since both define zmk_display_status_screen().

if ZMK_EPAPER_LAYERS

config ZMK_EPAPER_LAYERS_INVERTED
    bool "White on black"

endif # ZMK_EPAPER_LAYERS
```

## modules/pinnacle-tune/Kconfig
```kconfig
menuconfig PINNACLE_TUNE
    bool "Tune the Cirque Pinnacle beyond what Zephyr's driver exposes"
    depends on INPUT_PINNACLE && SPI
    default n
    help
      Runs once after the cirque,pinnacle driver's init: pauses the feed,
      writes the registers selected below over the same SPI bus, optionally
      forces a calibration, re-enables the feed, and logs the register
      values before and after. Only the node labelled `trackpad` on SPI is
      handled.

if PINNACLE_TUNE

config PINNACLE_TUNE_EDGE_SENSITIVITY
    bool "Edge sensitivity: write the WideZ-min registers (ERA 0x0149 / 0x0168)"
    default n
    help
      The values Cirque's sample code uses for curved overlays ("tune edge
      sensitivity"): lower than the chip's defaults (0x06 / 0x05), so a
      lighter finger stays detected near the rim.

config PINNACLE_TUNE_EDGE_X_WIDEZMIN
    hex "X axis WideZ-min (ERA 0x0149)"
    depends on PINNACLE_TUNE_EDGE_SENSITIVITY
    default 0x04

config PINNACLE_TUNE_EDGE_Y_WIDEZMIN
    hex "Y axis WideZ-min (ERA 0x0168)"
    depends on PINNACLE_TUNE_EDGE_SENSITIVITY
    default 0x03

config PINNACLE_TUNE_CALCONFIG1_CLEAR
    hex "CalConfig1 (0x07) bits to clear"
    default 0x00
    help
      0x02 background compensation, 0x04 NERD compensation, 0x08 track
      error compensation, 0x10 tap compensation, 0x20 palm error
      compensation (all enabled by default in the chip). 0 leaves the
      register alone.

config PINNACLE_TUNE_FEEDCONFIG3_SET
    hex "FeedConfig3 (0x06) bits to set"
    default 0x00
    help
      0x02 disable cross-rate smoothing, 0x04 disable palm/NERD measurement,
      0x08 disable noise avoidance, 0x10 disable wrap lockout, 0x20 disable
      dynamic EMI adjust (all features enabled by default in the chip). 0
      leaves the register alone.

config PINNACLE_TUNE_CALIBRATE
    bool "Force a calibration after the changes"
    default y

endif # PINNACLE_TUNE
```

## modules/xy-pack/Kconfig
```kconfig
DT_COMPAT_ZMK_INPUT_PROCESSOR_XY_PACK := zmk,input-processor-xy-pack
DT_COMPAT_ZMK_INPUT_PROCESSOR_XY_UNPACK := zmk,input-processor-xy-unpack

config ZMK_INPUT_PROCESSOR_XY_PACK
    bool "Input processor: pack a packet's REL_X/REL_Y into one event (split peripheral)"
    default $(dt_compat_enabled,$(DT_COMPAT_ZMK_INPUT_PROCESSOR_XY_PACK))
    depends on ZMK_POINTING

config ZMK_INPUT_PROCESSOR_XY_UNPACK
    bool "Input processor: unpack a packed X/Y event back into REL_X/REL_Y (split central)"
    default $(dt_compat_enabled,$(DT_COMPAT_ZMK_INPUT_PROCESSOR_XY_UNPACK))
    depends on ZMK_POINTING

config ZMK_INPUT_PROCESSOR_XY_PACK_STATS
    bool "Log one packet/gap summary per second of touchpad traffic (both processors)"
    depends on ZMK_INPUT_PROCESSOR_XY_PACK || ZMK_INPUT_PROCESSOR_XY_UNPACK
    default n
    help
      Each processor counts the packets it sees and the gaps between them
      and logs "xy_pack: N pkts in M ms, ..." (right half) or "xy_unpack:
      ..." (dongle) at INFO level under its own log module, so ZMK's own
      level can stay at WRN. Comparing the two logs shows whether a stall
      originates at the chip (both sides see the gap) or on the link / in a
      queue (only the dongle sees it).

config ZMK_INPUT_PROCESSOR_XY_PACK_TRACE
    bool "Log every packet on the split peripheral (dx, dy, gap) at INFO level"
    depends on ZMK_INPUT_PROCESSOR_XY_PACK
    default n
    help
      One line per packet from zip_xy_pack: "xy_pack: dx=.. dy=.. gap=..ms".
      About 100 lines/s while the finger moves, enough to saturate the USB
      console for long; meant for short controlled gestures (a straight
      stroke, a held finger) where the input is known and any hole, sign
      reversal or axis dropout in the output must be the chip's.
```

## modules/xy-pack/dts/bindings/input_processors/zmk,input-processor-xy-pack.yaml
```yaml
description: |
  Split-peripheral input processor (put it in the `input-processors` of the
  `zmk,input-split` node) that folds a relative pointing packet's REL_X and
  REL_Y into one event, halving the number of BLE notifications the split
  transport sends. The central must run `zmk,input-processor-xy-unpack`
  first in every chain of its input listener.

  Landing filter: a Cirque Pinnacle in relative mode reports a hump of
  motion in the first ~100 ms after the finger lands (the contact patch
  settling), 40-100 counts on this pad, always in the same direction
  (negative Y, i.e. up), before the stroke itself starts. The filter limits
  the per-packet delta in the first `landing-packets` packets of every new
  stroke (a packet after at least `landing-gap-ms` of silence) to
  `landing-max-up` / `landing-max-down` / `landing-max-x` counts. Motion
  that is genuinely small (a nudge) passes unchanged. At the end of the
  window the raw motion of its last two packets, compared with that of
  packets 3-4, tells a hump (peaked early, decayed) from a real stroke in
  the limited direction (still rising or sustained): for a stroke the
  withheld counts are paid back over the next `landing-refund-packets`
  packets, so it loses nothing.

compatible: "zmk,input-processor-xy-pack"

include: ip_zero_param.yaml

properties:
  landing-packets:
    type: int
    default: 8
    description: |
      Number of packets after a new touch during which the limits apply.
      0 disables the filter.
  landing-gap-ms:
    type: int
    default: 150
    description: |
      A packet arriving this long after the previous one starts a new stroke
      (relative mode is silent while the finger rests, so this also catches a
      resting finger that moves again; the limits are harmless there).
  landing-max-up:
    type: int
    default: 1
    description: Largest negative Y (up) per packet during the landing window.
  landing-max-down:
    type: int
    default: 1000
    description: Largest positive Y (down) per packet during the landing window.
  landing-max-x:
    type: int
    default: 1000
    description: Largest |X| per packet during the landing window.
  landing-refund-threshold:
    type: int
    default: 6
    description: |
      Floor for the raw |dx|+|dy| summed over the last two packets of the
      window; the touch counts as a real stroke (withheld motion paid back)
      when that sum is at least this and at least the same sum over packets
      3-4 (i.e. the motion did not decay). 0 never refunds.
  landing-refund-packets:
    type: int
    default: 4
    description: Packets over which the withheld motion is paid back. 0 disables refunds.
```

## modules/xy-pack/dts/bindings/input_processors/zmk,input-processor-xy-unpack.yaml
```yaml
description: |
  Split-central input processor that turns the event produced by
  `zmk,input-processor-xy-pack` on the peripheral back into REL_X and REL_Y.
  Must be the first processor in every chain (base and layer overrides) of
  the input listener. Passes everything else through, so it is harmless if
  the peripheral does not pack.

compatible: "zmk,input-processor-xy-unpack"

include: ip_zero_param.yaml
```
